#ifndef SSD1306_EMUL_H_
#define SSD1306_EMUL_H_ 1

#define uint8 unsigned char

//if defined char range 0x20-0x7F otherwise 0x20-0xFF
#define FONT_END7F
#define FONT_START (0x20) //first character

#define FONT_WIDTH (6)
#define FONT_HEIGHT (8)

const uint8_t font_PGM[] =
    {
        0x00, 0x00, 0x00, 0x00, 0x00, 0x00, 0x00, 0x00, // 0x20
        0x04, 0x0E, 0x0E, 0x04, 0x04, 0x00, 0x04, 0x00, // 0x21
        0x1B, 0x1B, 0x12, 0x00, 0x00, 0x00, 0x00, 0x00, // 0x22
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        0x04, 0x0E, 0x1B, 0x11, 0x11, 0x1F, 0x00, 0x00, // 0x7F
#ifndef FONT_END7F
        0x0E, 0x11, 0x10, 0x10, 0x11, 0x0E, 0x04, 0x0C, // 0x80
        0x12, 0x00, 0x12, 0x12, 0x12, 0x16, 0x0A, 0x00, // 0x81
        0x03, 0x00, 0x0E, 0x11, 0x1E, 0x10, 0x0E, 0x00, // 0x82
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        0x00, 0x00, 0x00, 0x00, 0x00, 0x00, 0x00, 0x00  // 0xFF
#endif
};

#define lcd_width 128
#define lcd_height 64

static int_least16_t drawChar(int_least16_t x, int_least16_t y, char c, uint_least16_t color, uint_least16_t bg, uint_least8_t size)
{
  int_least16_t ret, pos;
#if FONT_WIDTH <= 8
  uint_least8_t data, mask;
#elif FONT_WIDTH <= 16
  uint_least16_t data, mask;
#elif FONT_WIDTH <= 32
  uint_least32_t data, mask;
#endif
  uint_least8_t i, j, width, height;
  //const PROGMEM uint8_t *ptr;
  const uint8_t *ptr;

#if FONT_WIDTH <= 8
  pos = (c - FONT_START) * (8 * FONT_HEIGHT / 8);
#elif FONT_WIDTH <= 16
  pos = (c - FONT_START) * (16 * FONT_HEIGHT / 8);
#elif FONT_WIDTH <= 32
  pos = (c - FONT_START) * (32 * FONT_HEIGHT / 8);
#endif
  ptr = &font_PGM[pos];
  width = FONT_WIDTH;
  height = FONT_HEIGHT;
  size = size & 0x7F;

  if (size <= 1)
  {
    ret = x + width;
    if ((ret - 1) >= lcd_width)
    {
      return lcd_width + 1;
    }
    else if ((y + height - 1) >= lcd_height)
    {
      return lcd_width + 1;
    }

    //setArea(x, y, (x+width-1), (y+height-1));

    //drawStart();
    int xx = 0, yy = 0;
    for (; height != 0; height--)
    {
      // #if FONT_WIDTH <= 8
      //   data = pgm_read_byte(ptr); ptr+=1;
      data = *ptr;
      ptr += 1;
      // #elif FONT_WIDTH <= 16
      //       data = pgm_read_word(ptr); ptr+=2;
      // #elif FONT_WIDTH <= 32
      //       data = pgm_read_dword(ptr); ptr+=4;
      // #endif
      for (mask = (1 << (width - 1)); mask != 0; mask >>= 1)
      {
        if (data & mask)
        {
          //draw(color);
          __DrawPixel(x + xx, y + yy, color);
        }
        else
        {
          //draw(bg);
          // not for now as real SSD1306 does
          // __DrawPixel(x + xx, y + yy, bg);
        }
        xx++;
      }
      yy++;
      xx = 0;
    }
    //drawStop();
  }
  //   else
  //   {
  //     ret = x+(width*size);
  //     if((ret-1) >= lcd_width)
  //     {
  //       return lcd_width+1;
  //     }
  //     else if((y+(height*size)-1) >= lcd_height)
  //     {
  //       return lcd_width+1;
  //     }

  //     setArea(x, y, (x+(width*size)-1), (y+(height*size)-1));

  //     drawStart();
  //     for(; height!=0; height--)
  //     {
  // #if FONT_WIDTH <= 8
  //       data = pgm_read_byte(ptr); ptr+=1;
  // #elif FONT_WIDTH <= 16
  //       data = pgm_read_word(ptr); ptr+=2;
  // #elif FONT_WIDTH <= 32
  //       data = pgm_read_dword(ptr); ptr+=4;
  // #endif
  //       for(i=size; i!=0; i--)
  //       {
  //         for(mask=(1<<(width-1)); mask!=0; mask>>=1)
  //         {
  //           if(data & mask)
  //           {
  //             for(j=size; j!=0; j--)
  //             {
  //               draw(color);
  //             }
  //           }
  //           else
  //           {
  //             for(j=size; j!=0; j--)
  //             {
  //               draw(bg);
  //             }
  //           }
  //         }
  //       }
  //     }
  //     //drawStop();
  //   }

  return ret;
}

static void DrawChar(char c, uint8 x, uint8 y, uint8 brightness)
{
  drawChar(x, y, c, 1, 0, 1);
}

#endif